## zephyr/Kconfig
```kconfig
#
# Copyright (c) 2020 Legrand North America, LLC.
#
# SPDX-License-Identifier: Apache-2.0
#
# Kconfig to configure Zephyr OOT module OMX

menuconfig OMX
	bool "OMX (OOT Module eXample)"
	help
	  Enable Zephyr OOT OMX (Out-of-tree Module eXample)

if OMX

module = OMX
module-str = Log level for OMX module
module-help = Enable (Disable) OMX module debug message output
source "$(ZEPHYR_BASE)/subsys/logging/Kconfig.template.log_config"

rsource "subsys/Kconfig"

endif # OMX
```

## zephyr/manifests/zp/zephyr-v2.4.0/west.yml
```yaml
# The west manifest file for upstream Zephyr OOT module OMX.
#
# The per-installation west configuration file, .west/config, sets the
# path to the project containing this file in the [manifest] section's
# "path" variable.
#
# This imports the latest upstream Zephyr manifest file.
#
# You can pass your manifest repositories to west init when creating a
# new Zephyr installation. See the west documentation for more
# information.
#
# Beginning with west 0.8, the following command-line options
# can be used to initialize with a repository lacking a west.yml
# file at the top level.
#
#   west init
#     -m <repository>
#     --mr <branch_name>
#     --mf <manifest_pathname>
#     <workspace>

manifest:
  version: 0.7  # This file uses syntax from west 0.7

  defaults:
    remote: zephyrproject-rtos

  remotes:
    - name: zephyrproject-rtos
      url-base: https://github.com/zephyrproject-rtos

  #
  # Please add items below based on alphabetical order
  projects:
    - name: zephyr
      remote: zephyrproject-rtos
      revision: v2.4.0
      import: true
```

## zephyr/samples/module_hello/sample.yaml
```yaml
sample:
  description: Hello from <module> sample, the simplest Zephyr
    application including <module> default configuration
  name: hello from oot_module_example
common:
    tags: introduction
    harness: console
    harness_config:
      type: one_line
      regex:
        - "Hello from oot_module_example!"
tests:
  sample.basic.oot_module_example.hello:
    tags: introduction
```

## zephyr/subsys/Kconfig
```kconfig
# Copyright (c) 2020 Legrand North America, LLC.
# SPDX-License-Identifier: Apache-2.0

# Subsystem configuration options

comment "OMX Subsystems"

rsource "omx_module_hello/Kconfig"
```

## zephyr/subsys/omx_module_hello/Kconfig
```kconfig
# Copyright (c) 2020 Legrand North America, LLC.
# SPDX-License-Identifier: Apache-2.0


# Kconfig -

config OMX_MODULE_HELLO
    bool "OMX Module \"Hello\""
    select LOG
    help
      This option enables OMX Module Hello service

if OMX_MODULE_HELLO

module = OMX_MODULE_HELLO
module-str = Log level for OMX Module Hello
source "subsys/logging/Kconfig.template.log_config"

endif # OMX_MODULE_HELLO
```

## zephyr/west.yml
```yaml
# The west manifest file for upstream Zephyr module OMX.
#
# The per-installation west configuration file, .west/config, sets the
# path to the project containing this file in the [manifest] section's
# "path" variable.
#
# This imports the latest upstream Zephyr manifest file.
#
# You can pass your manifest repositories to west init when creating a
# new Zephyr installation. See the west documentation for more
# information.
#
# Beginning with west 0.8, the following command-line options
# can be used to initialize with a repository lacking a west.yml
# file at the top level.
#
#   west init
#     -m <repository>
#     --mr <branch_name>
#     --mf <manifest_pathname>
#     <workspace>

manifest:
  version: 0.9

  defaults:
    remote: zephyrproject-rtos

  remotes:
    - name: zephyrproject-rtos
      url-base: git@github.com:zephyrproject-rtos


  projects:
    - name: zephyr
      remote: zephyrproject-rtos
      revision: master
      import: true
```
