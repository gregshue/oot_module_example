## CMakeLists.txt
```
# SPDX-License-Identifier: Apache-2.0

cmake_minimum_required(VERSION 3.13.1)

# Extract module name and path

string(REGEX REPLACE
  "/zephyr/samples/[a-zA-Z_/-]*$" ""
  MODULE_NAME
  ${CMAKE_CURRENT_SOURCE_DIR})
get_filename_component(MODULE_NAME ${MODULE_NAME} NAME)
get_filename_component(PROJECT_NAME ${CMAKE_CURRENT_SOURCE_DIR} NAME)

find_package(Zephyr REQUIRED HINTS $ENV{ZEPHYR_BASE})
project(${PROJECT_NAME})

target_sources(app PRIVATE src/main.c)

add_definitions(-DPROJECT_NAME="${PROJECT_NAME}")
```

## sample.yaml
```
sample:
  description: Example of the simplest <module> project
  name: Example Module Project
common:
    tags: introduction
    harness: console
    harness_config:
      type: one_line
      regex:
        - "Hello from oot_module_example!"
tests:
  project.example.module_project:
    tags: introduction
```

## prj.conf
```kconfig
# nothing here
CONFIG_OMX=y
CONFIG_OMX_MODULE_HELLO=y
```

## src/main.c
```c
/*
 * Copyright (c) 2012-2014 Wind River Systems, Inc.
 *
 * SPDX-License-Identifier: Apache-2.0
 */

#include <zephyr.h>
#include <sys/printk.h>

void main(void)
{
	/* Do nothing here. Leave for test code. */
}
```
